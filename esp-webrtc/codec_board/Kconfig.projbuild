## esp-webrtc/codec_board/Kconfig.projbuild
```kconfig
menu "Codec Board Configuration"

choice
    prompt "Selection for codec board"
    default SZPI_ESP32S3_BOARD
    help
        Select a codec board
config ESP32_S3_BOX_3_BOARD
    depends on IDF_TARGET_ESP32S3
    bool "ESP32 S3 BOX 3"
config SZPI_ESP32S3_BOARD
    depends on IDF_TARGET_ESP32S3
    bool "SZPI ESP32S3 (LCKFB)"
endchoice

config CODEC_BOARD
    string
    default "ESP32_S3_BOX_3" if ESP32_S3_BOX_3_BOARD
    default "SZPI_ESP32S3" if SZPI_ESP32S3_BOARD
    default ""
endmenu
```

## main/Kconfig.projbuild
```kconfig
menu "Xiaozhi Assistant"

config OTA_URL
    string "Default OTA URL"
    default "https://api.tenclass.net/xiaozhi/ota/"
    help
        The application will access this URL to check for new firmwares and server address.

choice
    prompt "Flash Assets"
    default FLASH_DEFAULT_ASSETS if !USE_EMOTE_MESSAGE_STYLE
    default FLASH_EXPRESSION_ASSETS if USE_EMOTE_MESSAGE_STYLE
    help
        Select the assets to flash.

    config FLASH_NONE_ASSETS
        bool "Do not flash assets"
    config FLASH_DEFAULT_ASSETS
        bool "Flash Default Assets"
        depends on !USE_EMOTE_MESSAGE_STYLE
    config FLASH_CUSTOM_ASSETS
        bool "Flash Custom Assets"
    config FLASH_EXPRESSION_ASSETS
        bool "Flash Emote Assets"
        depends on USE_EMOTE_MESSAGE_STYLE
endchoice

config CUSTOM_ASSETS_FILE
    depends on FLASH_CUSTOM_ASSETS
    string "Custom Assets File"
    default "assets.bin"
    help
        The custom assets file to flash.
        It can be a local file relative to the project directory or a remote url.

choice BOARD_TYPE
    prompt "Board Type"
    default BOARD_TYPE_LICHUANG_DEV_S3
    help
        Select one of the board implementations available in this repository.

    config BOARD_TYPE_ESP_BOX_3
        bool "Espressif ESP-BOX-3"
        depends on IDF_TARGET_ESP32S3

    config BOARD_TYPE_LICHUANG_DEV_S3
        bool "Lichuang ESP32-S3 Development Board"
        depends on IDF_TARGET_ESP32S3
endchoice


choice DISPLAY_STYLE
    prompt "Select display style"
    default USE_DEFAULT_MESSAGE_STYLE
    help
        Select display style for Xiaozhi device

    config USE_DEFAULT_MESSAGE_STYLE
        bool "Enable default message style"

    config USE_WECHAT_MESSAGE_STYLE
        bool "Enable WeChat Message Style"

    config USE_EMOTE_MESSAGE_STYLE
        bool "Emote animation style"
        depends on BOARD_TYPE_ESP_BOX_3 || BOARD_TYPE_LICHUANG_DEV_S3
endchoice

config USE_MULTILINE_CHAT_MESSAGE
    bool "Use multiline chat message display (default mode only)"
    depends on USE_DEFAULT_MESSAGE_STYLE
    default n
    help
        When enabled, the chat message area in the default display mode shows
        multiple wrapped lines that grow upward from the bottom of the screen,
        with auto-adaptive height.
        When disabled (default), a single-line horizontally scrolling label
        is shown at the bottom of the screen.

choice WAKE_WORD_TYPE
    prompt "Wake Word Implementation Type"
    default USE_AFE_WAKE_WORD if IDF_TARGET_ESP32S3 && SPIRAM
    default WAKE_WORD_DISABLED
    help
        Choose the type of wake word implementation to use

    config WAKE_WORD_DISABLED
        bool "Disabled"
        help
            Disable wake word detection

    config USE_AFE_WAKE_WORD
        bool "Wakenet model with AFE"
        depends on IDF_TARGET_ESP32S3 && SPIRAM
        help
            Support AEC if available, requires ESP32 S3 and PSRAM

    config USE_CUSTOM_WAKE_WORD
        bool "Multinet model (Custom Wake Word)"
        depends on IDF_TARGET_ESP32S3 && SPIRAM
        help
            Requires ESP32 S3 and PSRAM

endchoice

config CUSTOM_WAKE_WORD
    string "Custom Wake Word"
    default "xiao tu dou"
    depends on USE_CUSTOM_WAKE_WORD
    help
        Custom Wake Word, use pinyin for Chinese, separated by spaces

config CUSTOM_WAKE_WORD_DISPLAY
    string "Custom Wake Word Display"
    default "小土豆"
    depends on USE_CUSTOM_WAKE_WORD
    help
        Greeting sent to the server after wake word detection

config CUSTOM_WAKE_WORD_THRESHOLD
    int "Custom Wake Word Threshold (%)"
    default 20
    range 1 99
    depends on USE_CUSTOM_WAKE_WORD
    help
        Custom Wake Word Threshold, range 1-99, the smaller the more sensitive, default 20

config SEND_WAKE_WORD_DATA
    bool "Send Wake Word Data"
    default y
    depends on USE_AFE_WAKE_WORD || USE_CUSTOM_WAKE_WORD
    help
        Send wake word data to the server as the first message of the conversation and wait for response

config WAKE_WORD_DETECTION_IN_LISTENING
    bool "Enable Wake Word Detection in Listening Mode"
    default n
    depends on USE_AFE_WAKE_WORD || USE_CUSTOM_WAKE_WORD
    help
        Enable wake word detection while in listening mode.
        When enabled, the device can detect wake word during listening,
        which allows interrupting the current conversation.
        When disabled (default), wake word detection is turned off during listening.

config USE_AUDIO_PROCESSOR
    bool "Enable Audio Noise Reduction"
    default y
    depends on IDF_TARGET_ESP32S3 && SPIRAM
    help
        Requires ESP32 S3 and PSRAM

config ENABLE_VAD_BARGE_IN
    bool "Interrupt TTS when user starts speaking"
    default y
    depends on USE_AUDIO_PROCESSOR && (BOARD_TYPE_ESP_BOX_3 || BOARD_TYPE_LICHUANG_DEV_S3)
    help
        During TTS playback, run AEC and VAD using the microphone and playback
        reference channels. Confirmed user speech aborts TTS and returns the
        device to listening. Boards without a clean playback reference should
        leave this disabled to avoid false interruptions.

config VAD_BARGE_IN_CONFIRM_MS
    int "Barge-in speech confirmation time (ms)"
    default 200
    range 50 1000
    depends on ENABLE_VAD_BARGE_IN
    help
        User speech must remain active for this duration before TTS is aborted.
        A longer duration reduces false triggers but increases interruption latency.

config USE_DEVICE_AEC
    bool "Enable Device-Side AEC"
    default n
    depends on USE_AUDIO_PROCESSOR && (BOARD_TYPE_ESP_BOX_3 || BOARD_TYPE_LICHUANG_DEV_S3)
    help
        To work properly, device-side AEC requires a clean output reference path from the speaker signal and physical acoustic isolation between the microphone and speaker.

config USE_SERVER_AEC
    bool "Enable Server-Side AEC (Unstable)"
    default n
    depends on USE_AUDIO_PROCESSOR
    help
        To work perperly, server-side AEC requires server support

config USE_AUDIO_DEBUGGER
    bool "Enable Audio Debugger"
    default n
    help
        Enable audio debugger, send audio data through UDP to the host machine

menu "WiFi Configuration Method"
    help
        WiFi Configuration Method Selection
    config USE_HOTSPOT_WIFI_PROVISIONING
        bool "Hotspot"
        default y
        help
            Use WiFi Hotspot to transmit WiFi configuration data
    config USE_ACOUSTIC_WIFI_PROVISIONING
        bool "Acoustic"
        help
            Use audio signal to transmit WiFi configuration data

    config USE_ESP_BLUFI_WIFI_PROVISIONING
        bool "Esp Blufi"
        help
            Use esp blufi protocol to transmit WiFi configuration data
        select BT_ENABLED
        select BT_BLE_42_FEATURES_SUPPORTED
        select BT_BLE_BLUFI_ENABLE
        select MBEDTLS_DHM_C
endmenu

config AUDIO_DEBUG_UDP_SERVER
    string "Audio Debug UDP Server Address"
    default "192.168.2.100:8000"
    depends on USE_AUDIO_DEBUGGER
    help
        UDP server address, format: IP:PORT, used to receive audio debugging data

config RECEIVE_CUSTOM_MESSAGE
    bool "Enable Custom Message Reception"
    default n
    help
        Enable custom message reception, allow the device to receive custom messages from the server (preferably through the MQTT protocol)

menu "Camera Configuration"
    depends on IDF_TARGET_ESP32S3

    comment "Warning: Please read the help text before modifying these settings."

    config XIAOZHI_CAMERA_ALLOW_JPEG_INPUT
        bool "Allow JPEG Input"
        default n
        help
            Allow JPEG Input format for the camera.

            This option may need to be enabled when using a USB camera.

            Not currently supported when used simultaneously with XIAOZHI_ENABLE_ROTATE_CAMERA_IMAGE.

    config XIAOZHI_ENABLE_HARDWARE_JPEG_ENCODER
        bool "Enable Hardware JPEG Encoder"
        default y
        depends on SOC_JPEG_ENCODE_SUPPORTED
        help
            Use the ESP32-S3 hardware JPEG encoder when supported by the selected configuration.

    config XIAOZHI_ENABLE_HARDWARE_JPEG_DECODER
        bool "Enable Hardware JPEG Decoder"
        default n
        depends on SOC_JPEG_DECODE_SUPPORTED && XIAOZHI_CAMERA_ALLOW_JPEG_INPUT
        help
            Use the ESP32-S3 hardware JPEG decoder when supported by the selected configuration.

    config XIAOZHI_ENABLE_CAMERA_DEBUG_MODE
        bool "Enable Camera Debug Mode"
        default n
        help
            Enable camera debug mode, print camera debug information to the console.
            Only works on boards that support camera.

    config XIAOZHI_ENABLE_CAMERA_ENDIANNESS_SWAP
        bool "Enable software camera buffer endianness swapping"
        default n
        depends on !CAMERA_SENSOR_SWAP_PIXEL_BYTE_ORDER
        help
            This option treats the camera buffer as a uint16_t[] array and performs byte-swapping (endianness conversion) on each element.

            Should only be modified by development board integration engineers.

            **Incorrect usage may result in incorrect image colors!**

            ATTENTION: If the option CAMERA_SENSOR_SWAP_PIXEL_BYTE_ORDER is available for your sensor, please use that instead.

    menuconfig XIAOZHI_ENABLE_ROTATE_CAMERA_IMAGE
        bool "Enable Camera Image Rotation"
        default n
        depends on !XIAOZHI_CAMERA_ALLOW_JPEG_INPUT
        help
            Enable camera image rotation, rotate the camera image to the correct orientation.
            Rotation is done in software unless a selected ESP32-S3 peripheral supports it.
            - For 180° rotation, use HFlip + VFlip instead of this option.

            Not currently supported when used simultaneously with XIAOZHI_CAMERA_ALLOW_JPEG_INPUT.

    if XIAOZHI_ENABLE_ROTATE_CAMERA_IMAGE
        choice XIAOZHI_CAMERA_IMAGE_ROTATION_ANGLE
            prompt "Camera Image Rotation Angle (clockwise)"
            default XIAOZHI_CAMERA_IMAGE_ROTATION_ANGLE_90
            help
                Camera image rotation angle.
            config XIAOZHI_CAMERA_IMAGE_ROTATION_ANGLE_90
                bool "90°"
            config XIAOZHI_CAMERA_IMAGE_ROTATION_ANGLE_270
                bool "270°"
            comment "For 180° rotation, use HFlip + VFlip instead of this option"
        endchoice
    endif
endmenu

menu "WebRTC Call (experimental)"
    config USE_WEBRTC_CALL
        bool "Enable standalone WebRTC audio/video call"
        default n
        depends on IDF_TARGET_ESP32S3 && SPIRAM
        help
            Standalone peer-to-peer audio/video call, independent from the
            assistant conversation. Controlled via MCP tools. Default off;
            when off it has zero effect on the build.

    if USE_WEBRTC_CALL
        choice WEBRTC_SIGNALING
            prompt "Signaling method"
            default WEBRTC_SIGNALING_APPRTC_WS
            help
                How the device and the browser exchange SDP/ICE. This picks the
                signaling plane only -- media always flows peer-to-peer, and a
                remote unlock is always required to arrive on the WebRTC
                DataChannel regardless of which option is selected here.

            config WEBRTC_SIGNALING_LOCAL_HTTP
                bool "Local HTTPS (device-hosted, LAN direct)"
                help
                    The device runs its own HTTPS signaling endpoint and serves a
                    built-in debug page at https://<device-ip>/webrtc/test, so no
                    external service is involved. HTTPS is mandatory rather than
                    optional: browsers only grant getUserMedia on a secure origin.
                    Needs a self-signed certificate pair under
                    main/webrtc/signaling/http_local/certs/ (see the README there);
                    the build fails without it.

                    SECURITY: this endpoint has no authentication. Any host on the
                    same LAN can POST a signaling message and become the peer. With
                    WEBRTC_DOORBELL_MODE enabled that makes "being on the same
                    WiFi" the effective barrier in front of the door lock, since a
                    peer that completes the handshake also gets the DataChannel.
                    Use it for development and demos on a network you control; the
                    external option below at least requires knowing the room
                    number. The firmware logs a warning at doorbell startup when
                    both are on.

            config WEBRTC_SIGNALING_APPRTC_WS
                bool "External AppRTC signaling service"
        endchoice

        config WEBRTC_SIGNALING_URL
            string "AppRTC signaling URL (room number is appended at runtime)"
            depends on WEBRTC_SIGNALING_APPRTC_WS
            default "wss://webrtc.espressif.com/join/"
            help
                Base URL of an AppRTC-compatible signaling service. The device
                joins <URL>/<room number>, where the room number is entered on
                the device and stored in NVS.

                Put no credentials in this URL -- it is reported over MCP.

        config WEBRTC_CALL_ENABLE_VIDEO
            bool "Send camera video (requires a camera on the board)"
            default y
            help
                Runtime auto-downgrades to audio-only if the board has no camera.

        config WEBRTC_DOORBELL_MODE
            bool "Doorbell mode (on-screen LVGL ring / open-door buttons)"
            default n
            depends on !USE_EMOTE_MESSAGE_STYLE
            select LV_USE_KEYBOARD
            help
                Adds an on-screen doorbell UI (LVGL) with call + open-door
                buttons, plus remote unlock over the WebRTC DataChannel.
                Requires an LVGL display (not available in emote style).

                Remote unlock drives the board's DOOR_LOCK_GPIO high for
                DOOR_LOCK_PULSE_MS (see boards/<board>/config.h) and only ever
                for a command that arrived on the DataChannel during an
                established call. The on-screen open-door button stays
                simulated (status text only) and never touches the GPIO.
                Boards that do not define DOOR_LOCK_GPIO get no lock at all.
    endif
endmenu

endmenu
```
